## boards/arm/xiaomi_bt_sensor/xiaomi_bt_sensor_defconfig
```kconfig
# SPDX-License-Identifier: Apache-2.0

CONFIG_SOC_SERIES_NRF51X=y
CONFIG_SOC_NRF51822_QFAA=y
CONFIG_BOARD_NRF51_XIAOMI_BT_SENSOR=y

# enable GPIO
CONFIG_GPIO=y

# enable the segment display driver
CONFIG_BU9795=y

# enable the temperature and humidity sensor
CONFIG_SENSOR=y
CONFIG_SHT3XD=y

# enable uart driver
CONFIG_SERIAL=y

# enable console
CONFIG_CONSOLE=y
CONFIG_UART_CONSOLE=y
```
